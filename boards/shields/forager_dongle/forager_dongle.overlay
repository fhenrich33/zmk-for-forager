/ {
    chosen {
        zmk,studio = &uart0;
        zmk,physical-layout = &default_layout;
    };

    default_layout: default_layout {
        compatible = "zmk,physical-layout";
        display-name = "Forager Dongle";

        transform = <&empty_transform>;
    };

    empty_transform: transform_0 {
        compatible = "zmk,physical-layout-transform";
    };
};
